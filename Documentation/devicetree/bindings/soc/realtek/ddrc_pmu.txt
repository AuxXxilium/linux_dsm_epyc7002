## Documentation/devicetree/bindings/soc/realtek/ddrc_pmu.txt
```
Realtek DDRC PMU dt-bindings
============================

Required properties:
- compatible:
        "realtek,rtd-16xxb-ddrc-pmu" for rtd16xxb family
- reg: address range of DDRC PMU

Performance Counters Subnode
----------------------------
Each subnode of Dbus PMU represents a set of PMC groups which has its own
counter groups and controlling mechanism, but will be enabled and disabled
together with Dbus PMU.

Required properties:
- compatible:
	"ddrc-"
	"ddrc-total"

Optional properties:
- nr_defects: the number of counters which may work incorrectly
- defects: array of the index of problematic counters

Example:

	ddrc-pmu: rtk-ddrc-pmu@94000 {
		compatible = "realtek,rtk-16xxb-ddrc-pmu";
		#address-cells = <1>;
		#size-cells = <1>;
		reg = <0x0 0x94000 0x0 0x0800>;

		ddrc: ddrc {
			nr_defects = <2>;
			defects = <1 3>;
		};
	};
```

## drivers/soc/realtek/Kconfig
```kconfig
menu "Realtek SoC drivers"

menuconfig RTD13XX_RTK_CODEC
	bool "Realtek RTD13XX Codec"
	default n
	help
	  Realtek RTD13XX codec support.

	  If unsure, say N.

config RTK_RESERVE_MEMORY
	bool "RTK Reserve Memory for Video/Image Codec"
	depends on ION_REALTEK && RTD13XX_RTK_CODEC
	default n

config RTD13XX_VE1_CODEC
	bool "RTK Video Engine 1 Codec"
	depends on RTD13XX_RTK_CODEC
	default n

config RTD13XX_IMAGE_CODEC
	bool "RTK Image Codec"
	depends on RTD13XX_RTK_CODEC
	default n

menuconfig RTD16XXB_RTK_CODEC
	bool "Realtek RTD16XXB Codec"
	default n
	help
	  Realtek RTD16XXB codec support.

	  If unsure, say N.

config RTK_RESERVE_MEMORY
	bool "RTK Reserve Memory for Video/Image Codec"
	depends on ION_REALTEK && RTD16XXB_RTK_CODEC
	default n

config RTD16XXB_VE1_CODEC
	bool "RTK Video Engine 1 Codec"
	depends on RTD16XXB_RTK_CODEC
	default n

config RTD16XXB_IMAGE_CODEC
	bool "RTK Image Codec"
	depends on RTD16XXB_RTK_CODEC
	default n

config REALTEK_SOC
	bool
	depends on ARCH_REALTEK
	default y
	help
	  Realtek SoC drivers.

	  If unsure, say N.

source "drivers/soc/realtek/common/Kconfig"
endmenu
```

## drivers/soc/realtek/common/Kconfig
```kconfig
config REALTEK_PM
	tristate "Realtek power management driver"
	default y
	help
	  Suspend to RAM and shutdown support.

config RTK_MCP
	bool "Realtek MCP driver"
	default n
	help
	  Realtek MCP driver

config RTK_SC_WRAP_FSS
	bool "Realtek FSS Driver"
	default n
	help
	  This enable FSS control interface, if not sure say N.

config RTK_USB_CTRL_MANAGER
	tristate "RTK Multiple USB Host/Device Controller Manager"
	default y if USB_OHCI_RTK || USB_EHCI_RTK || USB_DWC3_RTK
	help
	  The Realtek chips are Multiple host/peripheral USB controllers.
	  Enable the driver to control clock, reset and usb power gpio.

config REALTEK_CHIP_INFO
	bool "Realtek SoC information"
	default y
	select SOC_BUS
	help
	  The Realtek chips information.

config RTK_FAN
	bool "RTK Fan driver"
	default n
	help
	  Realtek Fan driver

config RTK_FSS_SCAN
	bool "Realtek FSS Scan Driver"
	default n
	help
	  This enable FSS Scan control interface, if not sure say N.

config RTK_VCPU
	bool "Realtek VCPU driver"
	select DEVFREQ_GOV_USERSPACE if PM_DEVFREQ
	default y
	help
	  This enables Realtek VCPU driver.

config RTK_VE3_UART
	bool "Realtek VE3 uart driver"
	default y
	help
	  This enables Realtek VE3 Pseudo Uart driver.

config RTK_WATCHDOG_STATUS
	tristate "Realtek Watchdog Status Driver"
	default n
	help
	  This enables Realtek Watchdog Status Driver to show
	  information of hardware controlled watchdog.

config RTK_GPIO_DEFAULT
	bool "Realtek GPIO default setting driver"
	default y
	help
	  This enables Realtek GPIO default setting driver to set gpio default value.

config RTK_VSFC_CTRL
	bool "Realtek VSFC Controller"
	depends on COMMON_CLK && REGULATOR
	help
	  This enables Realtek VSFC controller

config RTK_CPUHP_QOS
	bool

config RTK_CPUHP_CONTROL
	bool "Realtek CPU Hotplug Controller"
	select RTK_CPUHP_QOS
	help
	  This enables Realtek CPU Hotplug Controller

config RTK_CPU_VCLK
	bool "Realtek CPU virtual Clock"
	select RTK_CPUHP_QOS
	help
	  This driver provides equivalent frequencies of CPU clocks.

config RTK_BSV_CTRL
	bool "Realtek BSV Controller for CPU DVFS"
	help
	  This driver provides CPU voltage conversion based
	  on input frequency, if BSV OTP is valid.

source "drivers/soc/realtek/common/rpc/Kconfig"
source "drivers/soc/realtek/common/mem_allocator/Kconfig"
source "drivers/soc/realtek/common/hse/Kconfig"
source "drivers/soc/realtek/common/rtk_pd/Kconfig"
source "drivers/soc/realtek/common/info/Kconfig"
source "drivers/soc/realtek/common/dvfs/Kconfig"
source "drivers/soc/realtek/common/buflock/Kconfig"
```

## drivers/soc/realtek/common/buflock/Kconfig
```kconfig
config RTK_BUFLOCK
	bool "Realtek BUFLOCK driver"
	default n
	help
	  Realtek BUFLOCK driver
```

## drivers/soc/realtek/common/hse/Kconfig
```kconfig
config RTK_HSE
	bool "Realtek Highspeed Streaming Engine driver"
	default y if ARCH_REALTEK
	help
	  Enable Realtek HSE driver. If unsure, say N.
```

## drivers/soc/realtek/common/info/Kconfig
```kconfig
config RTK_INFO_PLL
	bool "add DebugFs for PLL info"
	depends on ARCH_REALTEK
	depends on DEBUG_FS
	default y
```

## drivers/soc/realtek/common/rpc/Kconfig
```kconfig
config REALTEK_RPC
	bool "Realtek RPC driver"
	depends on REALTEK_SOC
	default y
	help
	  Realtek RPC driver.

config REALTEK_RPC_VE3
	bool "Realtek VE3 RPC"
	depends on REALTEK_RPC
	help
	  Enable Realtek VE3 RPC.
```

## drivers/soc/realtek/common/rtk_pd/Kconfig
```kconfig
menu "Realtek Power Domain"

config PD_REALTEK
	bool "Realtek Power Domain Support"
	depends on PM
	depends on ARCH_REALTEK
	select PM_GENERIC_DOMAINS
	default y

config PD_RTD1295
	bool "Realtek RTD1295 Power Domain Driver"
	depends on PD_REALTEK
	default y
	help
	  Realtek RTD1295 Power Domain Driver Support

config PD_RTD1395
	bool "Realtek RTD1395 Power Domain Driver"
	depends on PD_REALTEK
	default y
	help
	  Realtek RTD1395 Power Domain Driver Support

config PD_RTD1619
	bool "Realtek RTD1619 Power Domain Driver"
	depends on PD_REALTEK
	default y
	help
	  Realtek RTD1619 Power Domain Driver Support

config PD_RTD1619B
	bool "Realtek RTD1619B Power Domain Driver"
	depends on PD_REALTEK
	default y
	help
	  Realtek RTD1619B Power Domain Driver Support

endmenu
```

## drivers/syno/Kconfig
```kconfig
# SPDX-License-Identifier: GPL-2.0
menu "Synology"

config SYNO_DM_FLASHCACHE
	tristate "Block level disk caching target"
	depends on BLK_DEV_DM
	default n

config SYNO_SYNOBIOS
	tristate "synobios"
	default n

endmenu
```

## synology/synoconfigs/Kconfig
```kconfig
menuconfig SYNO_FEATURES
	bool "Synology Enhancement Features"

if SYNO_FEATURES

source "synology/synoconfigs/Kconfig.platform"
source "synology/synoconfigs/Kconfig.basic"
source "synology/synoconfigs/Kconfig.network"
source "synology/synoconfigs/Kconfig.devices"
source "synology/synoconfigs/Kconfig.fs"
source "synology/synoconfigs/Kconfig.misc"

endif #SYNO_FEATURES
```
