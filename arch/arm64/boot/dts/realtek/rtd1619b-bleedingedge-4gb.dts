// SPDX-License-Identifier: (GPL-2.0-or-later OR BSD-2-Clause)
/*
 * Copyright (c) 2020-2021 Realtek Semiconductor Corp.
 */

/dts-v1/;

#include "rtd1619b-bleedingedge.dtsi"

/ {
	compatible = "realtek,bleeding-edge", "realtek,rtd1619b";
	model = "Realtek Bleeding Edge EVB (4GB)";

	memory@4000 {
		device_type = "memory";
		reg = <0x00004000 0x7fffc000>,
		      <0x80020000 0x080e0000>,
		      <0x8a100000 0x0defc000>,
		      <0x98200000 0x00df0000>,
		      <0x99000000 0x66000000>;
	};
};

&cma_resrved_4 {
	alloc-ranges=<0x00000000 0x60000000>;
};
